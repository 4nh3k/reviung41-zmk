## config/boards/shields/Kconfig.defconfig
```kconfig
if SHIELD_REVIUNG41

config CONFIG_USB
    default y

config CONFIG_ZMK_USB
    default y

config CONFIG_ZMK_USB_BOOT
    default y
```

## config/boards/shields/rev41/Kconfig.defconfig
```kconfig
if SHIELD_REV41_DONGLE

config ZMK_KEYBOARD_NAME
	default "Reviung 41"
	
config ZMK_SPLIT_BLE_ROLE_CENTRAL
	default y
	
config ZMK_USB
	default y

endif

if SHIELD_REV41_KEB

config ZMK_SPLIT
	default y

config ZMK_BLE
	default y
	
endif
```

## config/boards/shields/rev41/Kconfig.shield
```kconfig
config SHIELD_REV41_DONGLE
    def_bool $(shields_list_contains,rev41_dongle)

config SHIELD_REV41_KEB
    def_bool $(shields_list_contains,rev41_keb)
```
